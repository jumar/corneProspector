/*
 * Copyright (c) 2022 The ZMK Contributors
 *
 * SPDX-License-Identifier: MIT
 */

#include "corne.dtsi"

/ {
    chosen {
        zmk,kscan = &mock_kscan;
        wakeup-source;
        zephyr,display = &st7789;
    };

    mock_kscan: kscan_1 {
        compatible = "zmk,kscan-mock";
        columns = <0>;
        rows = <0>;
        events = <0>;
    };
};